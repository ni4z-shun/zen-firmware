#include "zen.dtsi"
#include <input/processors.dtsi>
#include <dt-bindings/zmk/input_transform.h>

&pointing_listener {
    input-processors =
        <&zip_xy_transform (INPUT_TRANSFORM_X_INVERT | INPUT_TRANSFORM_Y_INVERT)>; 
        //<&zip_temp_layer 1 500>; --マウスレイヤー機能 要らないのでコメントアウト(戻す場合は上行のセミコロンをコンマに)

    scroller {
        layers = <4>;
        input-processors =
            <&zip_xy_transform (INPUT_TRANSFORM_Y_INVERT)>,
            <&zip_xy_to_scroll_mapper>,
            <&scroll_scaler 1 28>;
        process-next;
    };
};

&zen_transform {
    col-offset = <7>;
};
